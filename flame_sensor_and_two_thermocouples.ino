#include "arduino_secrets.h"
/*

*/
#include <SPI.h>
#include <WiFiNINA.h>
#include "Adafruit_MAX31855.h"

//thermocouple 1
#define MAXDO   3
#define MAXCS   4
#define MAXCLK  5

//thermocouple 2
#define MAXDO2  7
#define MAXCS2  8
#define MAXCLK2 9

// initialize the Thermocouples
Adafruit_MAX31855 thermocouple1(MAXCLK, MAXCS, MAXDO);
Adafruit_MAX31855 thermocouple2(MAXCLK2, MAXCS2, MAXDO2);


char ssid[] = SECRET_SSID;        // your network SSID (name);//
char pass[] = SECRET_PASS;    // your network password (use for WPA, or use as key for WEP);//
int keyIndex = 0;                // your network key Index number (needed only for WEP)

int status = WL_IDLE_STATUS;
const int flameSens = A0;//set flame sensor to pin A0 
int flameValue;//set up the data variable for the sensor
WiFiServer server(80);

void setup() {

  // wait for MAX chip to stabilize
  delay(500);
  
  //Serial.begin(9600);//begin the serial monitor
  pinMode(flameSens, INPUT);//define flame sensor as an input
 
  if (!thermocouple1.begin()) {
    while (1) delay(10);
  }
  
  if (!thermocouple2.begin()) {
    while (1) delay(10);
  }
  
  while (status != WL_CONNECTED) {
    status = WiFi.begin(ssid, pass);
    delay(10000);
  }
  
  server.begin();
  IPAddress ip = WiFi.localIP();
}

void loop() {
  
  double tempf1 = thermocouple1.readFahrenheit();
  double tempf2 = thermocouple2.readFahrenheit();
  flameValue = analogRead(flameSens);//read the sensor value of flame sensor

  //Serial.println(flameVal);//print the data to the serial monitor

  WiFiClient client = server.available();   
  if (client) {                                        
    String currentLine = "";                
    while (client.connected()) {            
      if (client.available()) {             
        char c = client.read();                                 
        if (c == '\n') {    
          
          if (currentLine.length() == 0) {
          client.println("HTTP/1.1 200 OK");
          client.println("Content-Type: text/json");
          client.println("Connection: close");  // the connection will be closed after completion of the response
          client.println("Refresh: 5");  // refresh the page automatically every 5 sec
          client.println();
          //  client.println("<head><meta http-equiv=\"refresh\" content=\"5\"></head>");
          client.print("{\"tempf1\":\"");
          client.print(tempf1);
          client.print("\",");
          client.print("\"tempf2\":\"");
          client.print(tempf2);
          client.print("\",");
          client.print("\"flameValue\":\"");
          client.print(flameValue);
          client.print("\"}");
            break;
          }
          
          else {
            currentLine = "";
          }
        }
 
        else if (c != '\r') {
          currentLine += c;
        }
      }
    }

    client.stop();
    //Serial.println("client disconnected");
  }
  
  delay(3000);
}

